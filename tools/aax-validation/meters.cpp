#include "RavetAaxMeters.hpp"
#include "RavetGain.h"
#include <atomic>
#include <cstdlib>
#include <iostream>
#include <stdexcept>
#include <type_traits>
static_assert(!std::is_copy_constructible_v<ravet::aax::AaxPreparedMeters<6>>&&!std::is_move_constructible_v<ravet::aax::AaxPreparedMeters<6>>, "prepared SDK metadata retains one stable owner address");
static std::atomic<bool> measuring{false};static std::atomic<size_t> allocations{0},deletions{0};
void* operator new(size_t n){if(measuring.load())++allocations;if(auto p=std::malloc(n))return p;throw std::bad_alloc();}
void operator delete(void* p)noexcept{if(measuring.load())++deletions;std::free(p);}void operator delete(void* p,size_t)noexcept{::operator delete(p);}
void* operator new[](size_t n){return ::operator new(n);}void operator delete[](void* p)noexcept{::operator delete(p);}
void require(bool value,const char* reason){if(!value)throw std::runtime_error(reason);}
namespace fixture {
const RavetNativeTelemetryEntryV1* actual=nullptr;const RavetNativeProcessorEntryV1* origin=nullptr;
uint32_t creates=0,retires=0,infoCalls=0;int32_t infoStatus=0,snapshotStatus=0;bool throwInfo=false,throwSnapshot=false,corrupt=false,overflow=false;uint32_t late=11;
const RavetNativeProcessorEntryV1* core(){return origin;}
void* create(){++creates;return actual->create_cache();}void destroy(void* owner){++retires;actual->destroy_cache(owner);}
int32_t info(const void* owner,uint32_t index,RavetNativeTelemetryInfoV1* out){++infoCalls;if(index==late){if(throwInfo)throw 71;if(infoStatus)return infoStatus;}return actual->info(owner,index,out);}
int32_t snapshot(void* processor,const void* cache,RavetNativeTelemetryValueV1* out,uint32_t capacity){if(throwSnapshot)throw 77;if(snapshotStatus)return snapshotStatus;const auto status=actual->snapshot(processor,cache,out,capacity);if(!status&&corrupt){const uint64_t nan=UINT64_C(0x7ff8000000000001);std::memcpy(&out[11].value,&nan,8);}if(!status&&overflow){const uint64_t large=UINT64_C(0x7fefffffffffffff);std::memcpy(&out[0].value,&large,8);}return status;}
}
using namespace ravet::aax;
template<class S>void qualification(uint32_t bits){
 const auto* core=ravet_native_processor_v1(bits);const auto* audio=ravet_native_audio_state_v1(bits);fixture::actual=ravet_native_telemetry_v1(bits);fixture::origin=core;
 RavetNativeTelemetryEntryV1 table=*fixture::actual;table.processor_entry=fixture::core;table.create_cache=fixture::create;table.destroy_cache=fixture::destroy;table.info=fixture::info;table.snapshot=fixture::snapshot;
 std::array<AaxMeterBinding,6> bindings{{{101,10,"Input L peak",AAX_eMeterType_Input},{102,11,"Input L RMS",AAX_eMeterType_Input},{103,16,"Output L peak",AAX_eMeterType_Output},{104,17,"Output L RMS",AAX_eMeterType_Output},{105,19,"Output R peak",AAX_eMeterType_Output},{106,20,"Output R RMS",AAX_eMeterType_Output}}};
 fixture::creates=fixture::retires=fixture::infoCalls=0;
 AaxPreparedMeters<6> meters(core,&table,bindings.data());require(meters.valid()&&fixture::creates==1&&fixture::retires==1&&fixture::infoCalls==12,"complete temporary native metadata cache queried/retired before processor ownership");
 require(meters.binding(0)&&std::string(meters.binding(0)->name)=="Input L peak"&&!meters.binding(6),"immutable copied binding metadata and exact tap order");
 auto copied=*core;fixture::creates=fixture::retires=0;{AaxPreparedMeters<6> mismatch(&copied,&table,bindings.data());require(!mismatch.valid()&&fixture::creates==0&&fixture::retires==0,"copied exact-origin mismatch before metadata-cache creator");}
 auto duplicate=bindings;duplicate[5].meterId=duplicate[0].meterId;{AaxPreparedMeters<6> invalid(core,&table,duplicate.data());require(!invalid.valid()&&fixture::creates==0,"late duplicate host meter ID before creators");}
 for(bool throws:{false,true}){fixture::infoStatus=-701;fixture::throwInfo=throws;fixture::creates=fixture::retires=0;AaxPreparedMeters<6> invalid(core,&table,bindings.data());const auto& d=invalid.diagnosticsStopped();require(!invalid.valid()&&fixture::creates==1&&fixture::retires==1&&d.cacheRetireReturned,"late native metadata failure/throw retires unavoidable cache exactly once");require(throws?d.error==AaxMeterDiagnostics::Error::Exception: d.infoReturned&&d.infoStatus==-701,"metadata original returned status separate from unreturned throw");}fixture::infoStatus=0;fixture::throwInfo=false;
 ravet::native::NativeProcessorClient owner(core,audio,&table);require(owner.valid(),"actual Gain native owner exact audio and telemetry");RavetNativeProcessorConfigV1 config{};config.version=1;config.sample_rate=48000.;config.maximum_frames=64;config.maximum_events=32;config.bus_count=1;config.buses[0]={2,2};require(!owner.prepare(config),"native Gain32/64 prepare");
 std::array<RavetNativeParameterValueV1,2> values{{{1,.5f},{2,0.f}}};require(!owner.applyState(values.data(),2),"complete canonical Gain.5 intent");
 std::array<S,66> left{},right{},outL{},outR{};left.fill(S(.5));right.fill(S(-.25));outL.fill(S(77));outR.fill(S(77));const S* inputs[]={left.data(),right.data()};S* outputs[]={outL.data(),outR.data()};RavetNativeProcessorBusV1 bus{2,2,inputs,outputs};RavetNativeProcessorResultV1 report{};
 std::array<float,8> taps{};taps.fill(91.f);require(!owner.process(&bus,1,64,nullptr,0,nullptr,nullptr,0,report)&&meters.publish(owner,taps.data()),"authoritative Gain DSP then complete meter snapshot publication");const std::array<float,6> predicted{.5f,.5f,.25f,.25f,.125f,.125f};for(uint32_t i=0;i<6;++i)require(taps[i]==predicted[i],"independently predicted constant input/output peak/RMS");require(taps[6]==91.f&&taps[7]==91.f&&outL[64]==S(77),"tap/sample backing tails preserved");
 const auto saved=taps;fixture::corrupt=true;require(!meters.publish(owner,taps.data())&&taps==saved&&meters.diagnosticsStopped().snapshotReturned&&meters.diagnosticsStopped().snapshotStatus==0&&meters.diagnosticsStopped().error==AaxMeterDiagnostics::Error::Projection,"late malformed native field refuses all tap writes after successful snapshot");fixture::corrupt=false;
 fixture::snapshotStatus=-771;require(!meters.publish(owner,taps.data())&&taps==saved&&meters.diagnosticsStopped().snapshotReturned&&meters.diagnosticsStopped().snapshotStatus==-771,"exact native snapshot refusal no partial tap publication");fixture::snapshotStatus=0;fixture::throwSnapshot=true;require(!meters.publish(owner,taps.data())&&taps==saved&&!meters.diagnosticsStopped().snapshotReturned&&meters.diagnosticsStopped().error==AaxMeterDiagnostics::Error::Exception,"unreturned violating snapshot throw separate diagnostics/no replay");fixture::throwSnapshot=false;
 auto finiteBinding=bindings[0];finiteBinding.projection=AaxMeterProjection::FiniteFloat;AaxPreparedMeters<1> finite(core,&table,&finiteBinding);fixture::overflow=true;require(!finite.publish(owner,taps.data())&&taps==saved,"finite projected overflow after native snapshot preserves prior taps");require(meters.publish(owner,taps.data())&&taps[0]==1.f,"explicit UnitClamp whole-value projection avoids inferred dB");fixture::overflow=false;
 values[1].value=1.f;require(!owner.applyState(values.data(),2)&&!owner.process(&bus,1,64,nullptr,0,nullptr,nullptr,0,report)&&meters.publish(owner,taps.data())&&taps[2]==.5f&&taps[4]==.25f,"actual bypass meter taps follow authoritative dry output");
 require(!owner.reset()&&!owner.process(&bus,1,0,nullptr,0,nullptr,nullptr,0,report)&&meters.publish(owner,taps.data()),"zero-frame/reset publication uses consumer snapshot semantics");for(uint32_t i=0;i<6;++i)require(taps[i]==0.f,"reset native meter window zero, no invented decay");
 std::array<AaxMeterBinding,64> maximumBindings{};for(uint32_t i=0;i<64;++i){maximumBindings[i]=bindings[0];maximumBindings[i].meterId=1000+i;}AaxPreparedMeters<64> maximum(core,&table,maximumBindings.data());require(maximum.valid(),"maximum64 host taps prepared independently of full native telemetry count");std::array<float,66> maximumTaps{};maximumTaps.fill(91.f);require(!owner.process(&bus,1,64,nullptr,0,nullptr,nullptr,0,report)&&maximum.publish(owner,maximumTaps.data()),"maximum64 complete staged projection");for(uint32_t i=0;i<64;++i)require(maximumTaps[i]==.5f,"all64 ordered host taps from explicitly duplicated native source");require(maximumTaps[64]==91.f&&maximumTaps[65]==91.f,"maximum host tap backing tail");
 allocations=deletions=0;measuring=true;for(uint32_t i=0;i<10000;++i){require(!owner.process(&bus,1,64,nullptr,0,nullptr,nullptr,0,report)&&meters.publish(owner,taps.data())&&maximum.publish(owner,maximumTaps.data()),"prepared normal DSP/meter repeated publication");fixture::corrupt=true;require(!meters.publish(owner,taps.data())&&!maximum.publish(owner,maximumTaps.data()),"repeated late meter fault");fixture::corrupt=false;}measuring=false;require(!allocations&&!deletions,"ten-thousand prepared valid/late-fault meter cycles no ordinary C++ heap action");
}
int main(){try{qualification<float>(32);qualification<double>(64);std::cout<<"PASS prepared exact meter metadata/native Gain32/64 analytic peak/RMS/bypass/reset/whole late failure/status/10000 C++ zero-heap cycles\n";}catch(const std::exception& e){std::cerr<<e.what()<<'\n';return 1;}}
